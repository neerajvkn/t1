/ {
    kscan {
        compatible = "zmk,kscan-gpio-matrix";
        label = "KSCAN";

        // Rows
        row-gpios = <
            &gpio0 2  GPIO_ACTIVE_LOW  // Row 0: P0.02
        >;

        // Columns
        col-gpios = <
            &gpio0 4  GPIO_ACTIVE_LOW  // Column 0: P0.04 (X key)
            &gpio0 5  GPIO_ACTIVE_LOW  // Column 1: P0.05 (Z key)
        >;

        diode-direction = "COL2ROW";  // Diodes from column to row
    };
};
